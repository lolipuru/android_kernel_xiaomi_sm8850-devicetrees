// SPDX-License-Identifier: BSD-3-Clause
/*
 * Copyright (c) 2024 Qualcomm Innovation Center, Inc. All rights reserved.
 */

/dts-v1/;

#include "canoe-tp.dtsi"
#include "canoe-techpack-bindings.dtsi"
#include "audio/canoe-audio.dtsi"
#include "camera/canoe-camera.dtsi"
#include "data/canoe-ipa.dtsi"
#include "data/smem-mailbox.dtsi"
#include "display/display/canoe-sde.dtsi"
#include "dsp/canoe/canoe-dsp.dtsi"
#include "eva/canoe-eva.dtsi"
#include "fingerprint/canoe-fingerprint.dtsi"
#include "graphics/gpu/canoe-gpu.dtsi"
#include "graphics/gpu/canoe-gpu-pwrlevels.dtsi"
#include "mm/hfi_core/canoe-hfi-core.dtsi"
#include "mm/hw_fence/canoe-hw-fence.dtsi"
#include "mmrm/canoe/canoe-mmrm-test.dtsi"
#include "mmrm/canoe/canoe-mmrm.dtsi"
#include "synx/synx/canoe-synx.dtsi"
#include "video/canoe-vidc.dtsi"

/ {
		model = "Qualcomm Technologies, Inc. Canoe Alt. Thermal Profile SoC";
		compatible = "qcom,canoe";
		qcom,board-id = <0 0>;
};
