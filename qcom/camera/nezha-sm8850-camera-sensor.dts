// SPDX-License-Identifier: BSD-3-Clause
/*
 * Copyright (c) 2024 Qualcomm Innovation Center, Inc. All rights reserved.
 */

/dts-v1/;
/plugin/;

#include <dt-bindings/clock/qcom,gcc-canoe.h>
#include <dt-bindings/clock/qcom,camcc-canoe.h>
#include <dt-bindings/clock/qcom,cambistmclkcc-canoe.h>
#include <dt-bindings/interconnect/qcom,canoe.h>
#include <dt-bindings/interrupt-controller/arm-gic.h>
#include <dt-bindings/regulator/qcom,rpmh-regulator-levels.h>
#include <dt-bindings/clock/qcom,rpmh.h>
#include "nezha-sm8850-camera-sensor.dtsi"

/ {
	model = "Qualcomm Technologies, Inc. canoe/honu MTP";
	compatible = "qcom,canoe", "qcom,canoep", "qcom,canoe-mtp",
		"qcom,canoep-mtp", "qcom,mtp";
	qcom,msm-id = <660 0x10000>, <660 0x20000>, <661 0x10000>,
		<661 0x20000>, <0x1000294 0x10000>, <0x1000294 0x20000>,
		<0x1000295 0x10000>, <0x1000295 0x20000>,<0x10294 0x10000>,
		<0x10294 0x20000>, <0x10295 0x10000>, <0x10295 0x20000>,
		<0x1010294 0x10000>, <0x1010294 0x20000>, <0x1010295 0x10000>,
		<0x1010295 0x20000>;
	qcom,board-id = <8 0>;
	xiaomi,miboard-id = <0x5 0>;
};
